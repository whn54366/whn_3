## boards/shields/whn_ff/Kconfig.defconfig
```kconfig
if SHIELD_WHN_FF

# Name must be less than 16 characters long!
config ZMK_KEYBOARD_NAME
    default "whn_ff"

endif

# ---------------------
# Kconfig for shield "whn_ff" with board "nice_nano_v2"
# ---------------------
if BOARD_NICE_NANO_V2 && SHIELD_WHN_FF

config I2C
    default y

config ZMK_DISPLAY
    default y

if ZMK_DISPLAY

config I2C
    default y

config SSD1306
    default y

endif # ZMK_DISPLAY

if LVGL

config LV_Z_VDB_SIZE
    default 64

config LV_DPI_DEF
    default 148

config LV_Z_BITS_PER_PIXEL
    default 1

choice LV_COLOR_DEPTH
    default LV_COLOR_DEPTH_1
endchoice

endif # LVGL

endif
```
